## main/Kconfig.projbuild
```kconfig
menu "Enigma Bridge"

    config ENIGMA_STATUS_LED
        bool "Enable GPIO 48 NeoPixel status LED"
        default y
        help
            Disable this on ESP32-S3 boards without a NeoPixel on GPIO 48,
            especially if the pin is used for another purpose.

endmenu
```

## sdkconfig.defaults
```kconfig
CONFIG_ESPTOOLPY_FLASHSIZE_16MB=y
CONFIG_BT_ENABLED=y
CONFIG_BT_NIMBLE_ENABLED=y
CONFIG_BT_NIMBLE_ROLE_PERIPHERAL=y
CONFIG_BT_NIMBLE_MAX_CONNECTIONS=2
CONFIG_BT_NIMBLE_MAX_BONDS=4
CONFIG_BT_NIMBLE_NVS_PERSIST=y
CONFIG_BT_NIMBLE_ATT_PREFERRED_MTU=185
CONFIG_USB_HOST_CONTROL_TRANSFER_MAX_SIZE=256
CONFIG_ESP_CONSOLE_UART_DEFAULT=y
CONFIG_ESP_CONSOLE_SECONDARY_USB_SERIAL_JTAG=y
```
